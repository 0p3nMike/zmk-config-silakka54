## Kconfig
```kconfig
config SILAKKA54_CUSTOM_ART
    bool "Replace nice!view peripheral art with held_ether"
    default y
    depends on ZMK_DISPLAY && NICE_VIEW_WIDGET_STATUS
```

## config/boards/shields/nice_view_ether/Kconfig.shield
```kconfig
config SHIELD_NICE_VIEW_ETHER
    def_bool $(shields_list_contains,nice_view_ether)
```
